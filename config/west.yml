## config/west.yml
```yaml
manifest:
  remotes:
    - name: zmkfirmware
      url-base: https://github.com/zmkfirmware
    - name: rschenk
      url-base: https://github.com/rschenk
  projects:
    - name: zmk
      remote: zmkfirmware
      revision: v0.4
      import: app/west.yml
    - name: zmk-keyboard-re-gret
      remote: rschenk
      revision: v0.4
  self:
    path: config
```
